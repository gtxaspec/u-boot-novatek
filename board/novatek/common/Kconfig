## board/novatek/common/Kconfig
```kconfig
menu "Novatek IVOT features"
config NVT_IVOT_SOC
	bool "Novatek IVOT series soc"
	help
	  This option can be used to enable ivot features.

config NVT_IVOT_QEMU_SIM
	depends on NVT_IVOT_SOC
	default n
        bool "Novatek IVOT virtual platform (vp)"
        help
          This option can be used to enable ivot vp qemu simulation

config NVT_FPGA_EMULATION
	bool "Novatek IVOT FPGA emulation"
	default n
	help
	  This option can be used to enable FPGA emulation.

config NVT_IVOT_SOC_FW_UPDATE_SUPPORT
	bool "Novatek IVOT FW update utils"
	default n
	help
	  This option can be used to support fdt parsing and update api.

config NVT_IVOT_SOC_UTILS
	bool "Novatek IVOT utils"
	default n
	help
	  To support IVOT proprietary utilities.

config NVT_IVOT_SOC_BOOT_FROM_RAM
	bool "Novatek IVOT FW boot from ram"
	default n
	help
	  To support IVOT FW only boot from ram.

config NVT_IVOT_NVT_DBG
	bool "Novatek IVOT debug setting"
	default n
	help
	  To support IVOT message debug function.

config NVT_IVOT_DEBUG_LEVEL
	int "Debug msg print level (0-8)"
        default 4
        depends on NVT_IVOT_NVT_DBG
        help
          0 ~ 8: 8 is to turn on all print message

config NVT_IVOT_BOOT_FAST
	bool "Let your uboot booting time faster"
	default n
	help
	  This option can be used to accelerate boot time.

config NVT_IVOT_SECBOOT_SUPPORT
	bool "To support secure boot flow"
	depends on !NVT_IVOT_OPTEE_SUPPORT
	depends on NVT_CRYPTO
	depends on NVT_HASH
	depends on NVT_RSA
	default n
	help
	  To support secure boot flow

config NVT_IVOT_OPTEE_SUPPORT
	bool "To support the optee utils"
	default n
	help
	  This option is used to communicate with optee secure os.

config NVT_IVOT_OPTEE_SECBOOT_SUPPORT
	bool "To support secure boot flow with optee"
	depends on NVT_IVOT_OPTEE_SUPPORT
	default n
	help
	  To support secure boot flow with optee

config NVT_IVOT_TZPC_SUPPORT
	bool "To support TZPC related utils"
	default n
	help
	  This option is used to simple verify TZPC.

config NVT_IVOT_DDR_RANGE_SCAN_SUPPORT
	bool "To support DDR range scan utils"
	default n
	help
	  This option is used to lunch range scan.

	if NVT_IVOT_DDR_RANGE_SCAN_SUPPORT
    	menu "Novatek DDR scan uart selection"
			
			config NVT_DDR_SCAN_OUTPUT_MESSAGE_TO_UART0
				bool "DDR range scan utils output message to UART0"

			config NVT_DDR_SCAN_OUTPUT_MESSAGE_TO_UART1
				bool "DDR range scan utils output message to UART1"

			config NVT_DDR_SCAN_OUTPUT_MESSAGE_TO_UART2
				bool "DDR range scan utils output message to UART2"

        endmenu
	endif

config NVT_IVOT_STBC_PMC_SUPPORT
	bool "To support STBC power down utils"
	depends on TARGET_NA51102_A64
	default n
	help
	  This option is used to lunch range scan.

config VIDEO_LOGO
	bool "To support display LOGO"
	default n
	help
	  This option is used to lunch display LOGO.

config NVT_IVOT_CRYPTO_CMD
	bool "To support crypto engine command"
	depends on NVT_IVOT_SOC && NVT_IVOT_OPTEE_SUPPORT=n
	help
	  Novatek iVot Crypto Engine Command support.

config NVT_IVOT_HASH_CMD
	bool "To support hash engine command"
	depends on NVT_IVOT_SOC && NVT_IVOT_OPTEE_SUPPORT=n
	help
	  Novatek iVot Hash Engine Command support.

config NVT_IVOT_RSA_CMD
	bool "To support rsa engine command"
	depends on NVT_IVOT_SOC && NVT_IVOT_OPTEE_SUPPORT=n
	help
	  Novatek iVot RSA Engine Command support.

config NVT_IVOT_DUAL_RTOS
	bool "Dual RTOS mechanism"
	default n
	help
	  An alternate rtos mechanism only for RTOS_APP_MAIN = uvc

config NVT_SWITCH_SECURE
	bool "To support switch to novatek secure boot flow"
	default n
	help
	  Novatek iVot switch to secure boot command support.

endmenu		# Novatek IVOT features
```

## drivers/crypto/Kconfig
```kconfig
menu "Hardware crypto devices"

source drivers/crypto/fsl/Kconfig

if TARGET_NA51102 || TARGET_NA51102_A64
source drivers/crypto/nvt/na51102/Kconfig
endif

if TARGET_NS02201 || TARGET_NS02201_A64
source drivers/crypto/nvt/ns02201/Kconfig
endif

if TARGET_NS02201 || TARGET_NS02201_A64
source drivers/crypto/nvt/ns02201/Kconfig
endif

if TARGET_NS02302 || TARGET_NS02302_A64
source drivers/crypto/nvt/ns02302/Kconfig
endif

if TARGET_NS02301 || TARGET_NS02301_A32
source drivers/crypto/nvt/ns02301/Kconfig
endif

endmenu
```

## drivers/phy/novatek/Kconfig
```kconfig
#
# Phy drivers for Novatek platforms
#
config PHY_NOVATEK_PCIE_V2
        bool "Novatek PCIe PHY (V2) driver"
        depends on TARGET_NS02201_A64 && PCI
	select PHY
        default n
        help
          Enable this to support the Novatek PCIe PHY.
```

## drivers/pinctrl/novatek/Kconfig
```kconfig
#if ARCH_NOVATEK

config PINCTRL_NTK
	depends on PINCTRL_GENERIC
	bool

config PINCTRL_NS02302
	bool "Novatek NS02302 pin control"
	depends on PINCTRL_GENERIC && TARGET_NS02302_A64
	select PINCTRL_NTK

config PINCTRL_NS02501
	bool "Novatek NS02501 pin control"
	depends on PINCTRL_GENERIC && TARGET_NS02501
	select PINCTRL_NTK

#endif
```

## test/novatek/Kconfig
```kconfig
menuconfig UT_NOVATEK
    bool "Unit tests for ARCH_NOVATEK"
    depends on UNIT_TEST && ARCH_NOVATEK
    default n
    help
	  Enables the 'ut novatek' command which do ARCH_NOVATEK SOC unit tests

if UT_NOVATEK


config DEV_DEPENDENCE_EXAMPLE
	bool "example tests with device dependense"
	select CMD_DFU
	default n
	help
	  Enables example tests with device dependense

endif   # if UT_NOVATEK
```
